## drivers/mmc_htc/card/Kconfig
```kconfig
#
# MMC/SD card drivers
#

comment "MMC/SD/SDIO Card Drivers"

config MMC_BLOCK
	tristate "MMC block device driver"
	depends on BLOCK
	default y
	help
	  Say Y here to enable the MMC block device driver support.
	  This provides a block device driver, which you can use to
	  mount the filesystem. Almost everyone wishing MMC support
	  should say Y or M here.

config MMC_BLOCK_MINORS
	int "Number of minors per block device"
	depends on MMC_BLOCK
	range 4 256
	default 8
	help
	  Number of minors per block device. One is needed for every
	  partition on the disk (plus one for the whole disk).

	  Number of total MMC minors available is 256, so your number
	  of supported block devices will be limited to 256 divided
	  by this number.

	  Default is 8 to be backwards compatible with previous
	  hardwired device numbering.

	  If unsure, say 8 here.

config MMC_BLOCK_DEFERRED_RESUME
	bool "Deferr MMC layer resume until I/O is requested"
	depends on MMC_BLOCK
	default n
	help
	  Say Y here to enable deferred MMC resume until I/O
	  is requested. This will reduce overall resume latency and
	  save power when theres an SD card inserted but not being used.
```

## drivers/mmc_htc/host/Kconfig
```kconfig
#
# MMC/SD host controller drivers
#

comment "MMC/SD/SDIO Host Controller Drivers"

config MMC_MSM
	tristate "Qualcomm SDCC Controller Support"
	depends on MMC && ARCH_MSM
	help
	  This provides support for the SD/MMC cell found in the
          MSM and QSD SOCs from Qualcomm.

config MMC_MSM_SDIO_SUPPORT
	boolean "Qualcomm MSM SDIO support"
	depends on MMC_MSM
	help
	  This enables SDIO support in the msm_sdcc driver.

config MMC_MSM_CARD_HW_DETECTION
	boolean "Qualcomm MMC Hardware detection support"
	depends on MMC_MSM
	default n
	help
	  Select Y if the hardware has support to detect card insertion/removal.

config MMC_MSM_SDC1_SUPPORT
	boolean "Qualcomm SDC1 support"
	depends on MMC_MSM
	default y
	help
	  Select Y to enable Slot 1.

config MMC_MSM_SDC1_8_BIT_SUPPORT
	boolean "Qualcomm SDC1 8bit support"
	depends on MMC_MSM_SDC1_SUPPORT
	default n
	help
	  Select Y to enable 8bit support for Slot 1.

config MMC_MSM_SDC2_SUPPORT
	boolean "Qualcomm SDC2 support"
	depends on MMC_MSM
	default y
	help
	  Select Y to enable Slot 2.

config MMC_MSM_SDC2_8_BIT_SUPPORT
	boolean "Qualcomm SDC2 8bit support"
	depends on MMC_MSM_SDC2_SUPPORT
	default n
	help
	  Select Y to enable 8bit support for Slot 2.

config MMC_MSM_SDC3_SUPPORT
	boolean "Qualcomm SDC3 support"
	depends on MMC_MSM
	default n
	help
	  Select Y to enable Slot 3.

config MMC_MSM_SDC3_8_BIT_SUPPORT
	boolean "Qualcomm SDC3 8bit support"
	depends on MMC_MSM_SDC3_SUPPORT
	default n
	help
	  Select Y to enable 8bit support for Slot 3.

config MMC_MSM_SDC3_WP_SUPPORT
	boolean "Qualcomm SDC3 write protection support"
	depends on MMC_MSM_SDC3_SUPPORT
	default n
	help
	  Select Y to enable write protection support for Slot 3.

config MMC_MSM_SDC4_SUPPORT
	boolean "Qualcomm SDC4 support"
	depends on MMC_MSM
	default n
	help
	  Select Y to enable Slot 4.

config MMC_MSM_SDC4_8_BIT_SUPPORT
	boolean "Qualcomm SDC4 8bit support"
	depends on MMC_MSM_SDC4_SUPPORT
	default n
	help
	  Select Y to enable 8bit support for Slot 4.

config MMC_MSM_SDC5_SUPPORT
	boolean "Qualcomm SDC5 support"
	depends on MMC_MSM
	default n
	help
	  Select Y to enable Slot 5.

config MMC_MSM_SDC5_8_BIT_SUPPORT
	boolean "Qualcomm SDC5 8bit support"
	depends on MMC_MSM_SDC5_SUPPORT
	default n
	help
	  Select Y to enable 8bit support for Slot 5.

config MMC_MSM_SPS_SUPPORT
	bool "Use SPS BAM as data mover"
	depends on MMC_MSM && SPS
	default n
	help
	  Select Y to use SPS BAM as data mover
```
